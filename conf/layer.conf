## conf/layer.conf
```bitbake
# We have a conf and classes directory, add to BBPATH
BBPATH .= ":${LAYERDIR}"

# We have recipes-* directories, add to BBFILES
BBFILES += "${LAYERDIR}/recipes-*/*/*.bb \
            ${LAYERDIR}/recipes-*/*/*.bbappend"

BBFILE_COLLECTIONS += "meta-virtium"
BBFILE_PATTERN_meta-virtium = "^${LAYERDIR}/"
BBFILE_PRIORITY_meta-virtium = "6"

PNWHITELIST_meta-virtium += ' vttestcmd vtsecurecmd vtview'

LAYERDEPENDS_meta-virtium = "core"
LAYERSERIES_COMPAT_meta-virtium = "warrior zeus wrl"
```
